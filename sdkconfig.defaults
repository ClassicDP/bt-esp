## sdkconfig.defaults
```kconfig
# Override some defaults so BT stack is enabled and
# Classic BT is enabled
CONFIG_BT_ENABLED=y
CONFIG_BT_BLE_ENABLED=n
CONFIG_BTDM_CTRL_MODE_BR_EDR_ONLY=y
CONFIG_BTDM_CTRL_BR_EDR_MAX_SYNC_CONN=1
CONFIG_BT_BLUEDROID_ENABLED=y
CONFIG_BT_CLASSIC_ENABLED=y
CONFIG_BT_HFP_ENABLE=y
CONFIG_BT_HFP_AG_ENABLE=y

# HFP Audio configuration - use basic SCO for maximum compatibility
CONFIG_BT_HFP_AUDIO_DATA_PATH_HCI=y
# CONFIG_BT_HFP_WBS_ENABLE is not set - disable wide band speech for compatibility

# Bluetooth controller settings for basic SCO compatibility
CONFIG_BTDM_CTRL_BR_EDR_SCO_DATA_PATH_HCI=y

# Use larger stacks for better stability
CONFIG_BT_BTC_TASK_STACK_SIZE=8192
CONFIG_BT_BTU_TASK_STACK_SIZE=8192
```
